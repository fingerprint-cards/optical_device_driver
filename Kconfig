## Kconfig
```kconfig
#
# FPC sensors
#

config FINGERPRINT_FPC
	tristate "FPC fingerprint sensor support"
	help
		If you say yes here you get support for fingerprint
		sensors from Fingerprint Cards (FPC). It support qcom
		platform by default.
```
